## configs/aarch64_defconfig
```kconfig
BR2_ROOTFS_OVERLAY="$(BR2_EXTERNAL_architest_PATH)/board/bpf_test/overlay/"

# Architecture
BR2_aarch64=y
BR2_cortex_a53=y

BR2_PACKAGE_HOST_LINUX_HEADERS_CUSTOM_5_15=y
BR2_SYSTEM_DHCP="eth0"
BR2_ROOTFS_POST_IMAGE_SCRIPT="$(BR2_EXTERNAL_architest_PATH)/board/bpf_test/post-image.sh"
BR2_PACKAGE_BUSYBOX_CONFIG="$(BR2_EXTERNAL_architest_PATH)/configs/busybox.config"
BR2_ROOTFS_POST_SCRIPT_ARGS="$(BR2_DEFCONFIG)"

# Custom BTF kernel customizations
BR2_LINUX_KERNEL_CONFIG_FRAGMENT_FILES="$(BR2_EXTERNAL_architest_PATH)/board/bpf_test/linux.config"
BR2_LINUX_KERNEL_NEEDS_HOST_PAHOLE=y

# Kernel 5.15 failed to build with pahole 2.24, downgrading to 2.22
BR2_PACKAGE_HOST_PAHOLEOLD=y
# This is a hack because I didn't find a way to override pahole with the old version:
# - I've added a host-paholeold package with pahole 2.22
# - I make sure to build it after host-pahole, so that it overridedes host/usr/bin/pahole
LINUX_DEPENDENCIES+=host-paholeold
HOST_PAHOLEOLD_DEPENDENCIES+=host-pahole

# BR2_PACKAGE_HOST_ELFUTILS=y
# BR2_PACKAGE_HOST_LIBBPF=y
# BR2_PACKAGE_OVERRIDE_FILE="$(BR2_EXTERNAL_architest_PATH)/package_overrides/pahole.mk"

BR2_LINUX_KERNEL=y
BR2_LINUX_KERNEL_LATEST_VERSION=y
BR2_LINUX_KERNEL_VERSION="6.0.9"

# BR2_LINUX_KERNEL_CUSTOM_VERSION=y
# BR2_LINUX_KERNEL_CUSTOM_VERSION_VALUE="5.15.18"

BR2_LINUX_KERNEL_USE_CUSTOM_CONFIG=y
BR2_LINUX_KERNEL_CUSTOM_CONFIG_FILE="board/qemu/aarch64-virt/linux.config"
BR2_LINUX_KERNEL_NEEDS_HOST_LIBELF=y

# qemu support
BR2_TARGET_ROOTFS_EXT2=y
BR2_PACKAGE_HOST_QEMU=y
BR2_PACKAGE_HOST_QEMU_SYSTEM_MODE=y

# Extra packages
BR2_PACKAGE_OPENSSH=y
```

## configs/x86_64_defconfig
```kconfig
BR2_ROOTFS_OVERLAY="$(BR2_EXTERNAL_testeroot_PATH)/board/bpf_test/overlay/"

BR2_x86_64=y
BR2_PACKAGE_HOST_LINUX_HEADERS_CUSTOM_5_15=y
BR2_SYSTEM_DHCP="eth0"
BR2_ROOTFS_POST_BUILD_SCRIPT="board/qemu/x86_64/post-build.sh"
BR2_ROOTFS_POST_IMAGE_SCRIPT="$(BR2_EXTERNAL_testeroot_PATH)/board/bpf_test/post-image.sh"
BR2_PACKAGE_BUSYBOX_CONFIG="$(BR2_EXTERNAL_testeroot_PATH)/configs/busybox.config"
BR2_ROOTFS_POST_SCRIPT_ARGS="$(BR2_DEFCONFIG)"

# Custom BTF kernel customizations
BR2_LINUX_KERNEL_CONFIG_FRAGMENT_FILES="$(BR2_EXTERNAL_testeroot_PATH)/board/bpf_test/linux.config"
BR2_LINUX_KERNEL_NEEDS_HOST_PAHOLE=y


BR2_LINUX_KERNEL=y
# BR2_LINUX_KERNEL_LATEST_VERSION=y
# BR2_LINUX_KERNEL_VERSION="6.0.9"

BR2_LINUX_KERNEL_CUSTOM_VERSION=y
BR2_LINUX_KERNEL_CUSTOM_VERSION_VALUE="5.15.18"

BR2_LINUX_KERNEL_USE_CUSTOM_CONFIG=y
BR2_LINUX_KERNEL_CUSTOM_CONFIG_FILE="board/qemu/x86_64/linux.config"
BR2_LINUX_KERNEL_NEEDS_HOST_LIBELF=y

# qemu support
BR2_TARGET_ROOTFS_EXT2=y
BR2_PACKAGE_HOST_QEMU=y
BR2_PACKAGE_HOST_QEMU_SYSTEM_MODE=y

# Extra packages
BR2_PACKAGE_OPENSSH=y
```

## package/paholeold/Config.in.host
```kconfig
config BR2_PACKAGE_HOST_PAHOLEOLD
	bool "host pahole 1.22"
	help
	  Pahole and other DWARF utils.

	  https://git.kernel.org/pub/scm/devel/pahole/pahole.git
```
